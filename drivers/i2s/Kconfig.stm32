## drivers/i2s/Kconfig.stm32
```kconfig
# STM32 I2S driver configuration options

# Copyright (c) 2018 STMicroelectronics
# SPDX-License-Identifier: Apache-2.0

menuconfig I2S_STM32
	bool "STM32 MCU I2S controller driver"
	default y
	depends on DT_HAS_ST_STM32_I2S_ENABLED
	select CACHE_MANAGEMENT if DCACHE
	select DMA
	select PINCTRL
	help
	  Enable I2S support on the STM32 family of processors.
	  (Tested on the STM32F4 & STM32H7 series)

if I2S_STM32

config I2S_STM32_RX_BLOCK_COUNT
	int "RX queue length"
	default 4

config I2S_STM32_TX_BLOCK_COUNT
	int "TX queue length"
	default 4

endif # I2S_STM32

menuconfig I2S_STM32_SAI
	bool "STM32 MCU SAI controller driver"
	default y
	depends on DT_HAS_ST_STM32_SAI_ENABLED
	select CACHE_MANAGEMENT if DCACHE
	select DMA
	select USE_STM32_HAL_DMA
	select USE_STM32_HAL_DMA_EX
	select USE_STM32_HAL_SAI
	select USE_STM32_HAL_SAI_EX if SOC_SERIES_STM32F4X
	help
	  Enable SAI support on the STM32 family of processors.

if I2S_STM32_SAI

config I2S_STM32_SAI_BLOCK_COUNT
	int "SAI queue length"
	default 4

config I2S_STM32_SAI_CONTINUOUS_RX_N6
	bool "STM32N6 continuous linked-list SAI receive"
	depends on SOC_SERIES_STM32N6X
	default n
	depends on I2S_STM32_SAI_BLOCK_COUNT >= 8
	help
	  Use a finite GPDMA linked-list for continuous SAI receive on STM32N6.
	  The application must release each buffer with stm32_sai_rx_release().

endif # I2S_STM32_SAI
```

## dts/bindings/sensor/sensirion,scd41.yaml
```yaml
# Copyright (c) 2024, Jan Fäh
# SPDX-License-Identifier: Apache-2.0

description: Sensirion SCD4x temperature sensor

compatible: "sensirion,scd41"

include: [sensor-device.yaml, i2c-device.yaml]

properties:
  mode:
    type: int
    required: true
    description: |
      - 0: Normal periodic measurement. Default interval of 5sec
      - 1: Low power periodic measurement. Interval of 30sec
      - 2: Singleshot measurement for low power usage.
      - 3: Single shot, retaining powered idle and ASC state between conversions.
           The first conversion after initialization is discarded. Fetch blocks
           for two 5-second conversions initially and one thereafter.
           The application owns sampling cadence; no power-down is issued.
    enum:
      - 0
      - 1
      - 2
      - 3
```
