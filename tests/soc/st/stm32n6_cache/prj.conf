## CMakeLists.txt
```
# Copyright (c) 2026 The Zephyr Project Contributors
#
# SPDX-License-Identifier: Apache-2.0

cmake_minimum_required(VERSION 3.20.0)

find_package(Zephyr REQUIRED HINTS $ENV{ZEPHYR_BASE})
project(stm32n6_cache)

target_sources(app PRIVATE src/main.c)
```

## prj.conf
```kconfig
# Intentionally empty: this test verifies the SoC default.
```

## src/main.c
```c
/*
 * Copyright (c) 2026 The Zephyr Project Contributors
 *
 * SPDX-License-Identifier: Apache-2.0
 */

#include <zephyr/sys/util.h>

BUILD_ASSERT(IS_ENABLED(CONFIG_CACHE_MANAGEMENT));

int main(void)
{
	return 0;
}
```
