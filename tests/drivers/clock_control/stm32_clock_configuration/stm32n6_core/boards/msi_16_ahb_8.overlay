/*
 * SPDX-FileCopyrightText: Copyright The Zephyr Project Contributors
 * SPDX-License-Identifier: Apache-2.0
 */

#include "msi_4.overlay"

&clk_msi {
	msi-range = <1>;
};

&cpusw {
	clock-frequency = <DT_FREQ_M(16)>;
};

&rcc {
	clock-frequency = <DT_FREQ_M(16)>;
	ahb-prescaler = <2>;
};
