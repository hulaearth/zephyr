/*
 * Copyright (c) 2026 The Zephyr Project Contributors
 *
 * SPDX-License-Identifier: Apache-2.0
 */

#include "../boards/mps2_an385.overlay"

/ {
	chosen {
		mcuboot,ram-load-dev = &image_ram;
		/delete-property/ mcuboot,image-ram;
	};
};
